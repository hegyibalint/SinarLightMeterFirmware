## CMakeLists.txt
```
# SPDX-License-Identifier: Apache-2.0

cmake_minimum_required(VERSION 3.20.0)

find_package(Zephyr REQUIRED HINTS $ENV{ZEPHYR_BASE})
project(blinky)

target_sources(app PRIVATE src/main.c src/sensor.c src/comm.c)
```

## prj.conf
```kconfig
# =============================================================================
# BLUETOOTH
# =============================================================================

CONFIG_BT=y
CONFIG_BT_PERIPHERAL=y

# Appearance is light meter
CONFIG_BT_DEVICE_APPEARANCE=1355
CONFIG_BT_DEVICE_NAME="Sinar Light Meter"
CONFIG_BT_DEVICE_NAME_DYNAMIC=n

# =============================================================================
# GPIO
# =============================================================================
CONFIG_GPIO=y

# =============================================================================
# DEBUGGING
# =============================================================================

# CONFIG_INIT_STACKS=y
# CONFIG_THREAD_ANALYZER=y
# CONFIG_THREAD_ANALYZER_USE_LOG=y
# CONFIG_THREAD_ANALYZER_AUTO=y
# CONFIG_THREAD_ANALYZER_AUTO_INTERVAL=5

CONFIG_SERIAL=y
CONFIG_LOG=y

CONFIG_BT_DEBUG_LOG=n
CONFIG_DEBUG_OPTIMIZATIONS=y
CONFIG_DEBUG_THREAD_INFO=y
```

## src/main.c
```c
/*
 * Copyright (c) 2016 Intel Corporation
 *
 * SPDX-License-Identifier: Apache-2.0
 */

#include <zephyr.h>
#include <logging/log.h>

#include <bluetooth/bluetooth.h>
#include <bluetooth/conn.h>
#include <bluetooth/uuid.h>
#include <bluetooth/gatt.h>

#include <devicetree.h>
#include <drivers/gpio.h>

#include "sensor.h"
#include "comm.h"

LOG_MODULE_REGISTER(main, LOG_LEVEL_DBG);

// ============================================================================
// Queues
// ============================================================================

K_MSGQ_DEFINE(sensor_queue, sizeof(struct sensor_data), 16, 4);

// ============================================================================
// Threads
// ============================================================================

#define SENSOR_THREAD_PRIO 5
K_THREAD_DEFINE(
	sensor_tid,
	256,
	sensor_thread_entry,
	NULL, NULL, NULL,
	SENSOR_THREAD_PRIO, 0, 0);

#define COMM_THREAD_PRIO 5
K_THREAD_DEFINE(
	comm_tid,
	1024,
	comm_thread_entry,
	NULL, NULL, NULL,
	COMM_THREAD_PRIO, 0, 0);

// ============================================================================
// GPIO devices
// ============================================================================

// Run LED --------------------------------------------------------------------

static const struct gpio_dt_spec run_led_dt = GPIO_DT_SPEC_GET(DT_NODELABEL(led0), gpios);


// ============================================================================
// Initialization
// ============================================================================

void main_init(void)
{
	int err;
	LOG_INF("Initializing main thread");

	// GPIOs ------------------------------------------------------------------

	err = gpio_pin_configure_dt(&run_led_dt, GPIO_OUTPUT_HIGH);
	if (err)
	{
		printk("Run LED configuring failed");
		k_fatal_halt(K_ERR_KERNEL_PANIC);
	}

	LOG_INF("Main initialization complete");
}

// ============================================================================
// Entry
// ============================================================================

void main(void)
{
	LOG_INF("Starting Light Meter...");
	main_init();

	for (int i = 0; i < 5; i++) {
		k_sleep(K_MSEC(100));
		gpio_pin_toggle(run_led_dt.port, run_led_dt.pin);
	}

	while (1)
	{
		k_sleep(K_SECONDS(1));
		gpio_pin_toggle(run_led_dt.port, run_led_dt.pin);
	}
}
```

## src/comm.c
```c
#include "comm.h"

#include <zephyr.h>
#include <logging/log.h>

#include <bluetooth/bluetooth.h>
#include <bluetooth/conn.h>
#include <bluetooth/uuid.h>
#include <bluetooth/gatt.h>

#include <devicetree.h>
#include <drivers/gpio.h>

LOG_MODULE_REGISTER(comm, LOG_LEVEL_DBG);

// ============================================================================
// Condition variables
// ============================================================================

K_CONDVAR_DEFINE(indicating_condvar);
K_MUTEX_DEFINE(indicating_mutex);

// ============================================================================
// Queues
// ============================================================================

extern struct k_msgq sensor_queue;

// ============================================================================
// GPIO devices
// ============================================================================

static const struct gpio_dt_spec con_led_dt = GPIO_DT_SPEC_GET(DT_NODELABEL(led1), gpios);

// ============================================================================
// Bluetooth connection tracking
// ============================================================================

static void bt_connected(struct bt_conn *conn, uint8_t err)
{
	if (err)
	{
		LOG_INF("Connection failed (err 0x%02x)", err);
	}
	else
	{
		LOG_INF("Connected");
		gpio_pin_set(con_led_dt.port, con_led_dt.pin, 1);
	}
}

static void bt_disconnected(struct bt_conn *conn, uint8_t reason)
{
	LOG_INF("Disconnected (reason 0x%02x)", reason);
	gpio_pin_set(con_led_dt.port, con_led_dt.pin, 0);
}

BT_CONN_CB_DEFINE(conn_callbacks) = {
	.connected = bt_connected,
	.disconnected = bt_disconnected,
};

// ============================================================================
// Bluetooth read/writes
// ============================================================================

// Sensor CCC write  ----------------------------------------------------------

/**
 * @brief storing if the indication is turned on
 */
static uint8_t sensor_indicate = 0U;

static void write_sensor_ccc(const struct bt_gatt_attr *attr, uint16_t value)
{
	sensor_indicate = (value == BT_GATT_CCC_INDICATE) ? 1 : 0;
	LOG_INF("Sensor indication is set to: %d", value);
}

// Sensor data indication -----------------------------------------------------

/**
 * @brief storing if an indication is in progress
 */
static struct bt_gatt_indicate_params sensor_indicate_params;

static void sensor_indicate_start(
	struct bt_conn *conn,
	struct bt_gatt_indicate_params *params,
	uint8_t err)
{
	LOG_INF("Indication %s", err != 0U ? "fail" : "success");
}

static void sensor_indicate_end(struct bt_gatt_indicate_params *params)
{
	LOG_INF("Indication complete");
	k_condvar_signal(&indicating_condvar);
}

// ============================================================================
// Bluetooth attribute definitions
// ============================================================================

#define VND_UUID BT_UUID_128_ENCODE(0xf28e76d6, 0x40f5, 0x43a3, 0xb2a4, 0x8deac278fb30)
static struct bt_uuid_128 sensor_service_uuid = BT_UUID_INIT_128(VND_UUID);

#define POS_UUID BT_UUID_128_ENCODE(0xf28e76d6, 0x40f5, 0x43a3, 0xb2a4, 0x8deac278fb31)
static struct bt_uuid_128 sensor_attr_uuid = BT_UUID_INIT_128(POS_UUID);

BT_GATT_SERVICE_DEFINE(sensor_service,
					   BT_GATT_PRIMARY_SERVICE(&sensor_service_uuid),
					   BT_GATT_CHARACTERISTIC(
						   &sensor_attr_uuid.uuid,
						   BT_GATT_CHRC_INDICATE,
						   BT_GATT_PERM_READ,
						   NULL, NULL, NULL),
					   BT_GATT_CCC(
						   write_sensor_ccc,
						   BT_GATT_PERM_READ | BT_GATT_PERM_WRITE));

// ============================================================================
// Bluetooth initialization
// ============================================================================

static const struct bt_data ad[] = {
	BT_DATA_BYTES(BT_DATA_FLAGS, (BT_LE_AD_GENERAL | BT_LE_AD_NO_BREDR)),
	BT_DATA_BYTES(BT_DATA_UUID128_ALL, VND_UUID),
};

static void bt_ready(int err)
{
	if (err)
	{
		LOG_INF("Bluetooth init failed (err %d)", err);
		return;
	}
	LOG_INF("Bluetooth initialized");

	err = bt_le_adv_start(BT_LE_ADV_CONN_NAME, ad, ARRAY_SIZE(ad), NULL, 0);
	if (err)
	{
		LOG_INF("Advertising failed to start (err %d)", err);
		return;
	}
}

// ============================================================================
// Entry
// ============================================================================

void comm_init(void)
{
	int err;
	struct bt_gatt_attr *sensor_attr;

	LOG_INF("Initializing communication thread");

	// Bluetooth ------------------------------------------------------------------

	err = bt_enable(bt_ready);
	if (err)
	{
		LOG_ERR("Bluetooth init failed (err %d)", err);
		k_fatal_halt(K_ERR_KERNEL_PANIC);
	}

	// GPIOs ------------------------------------------------------------------

	err = gpio_pin_configure_dt(&con_led_dt, GPIO_OUTPUT_LOW);
	if (err)
	{
		LOG_ERR("Connection LED configuring failed");
		k_fatal_halt(K_ERR_KERNEL_PANIC);
	}

	// BT indication ----------------------------------------------------------
	sensor_attr = bt_gatt_find_by_uuid(
		sensor_service.attrs, 
		sensor_service.attr_count,
		&sensor_attr_uuid.uuid);
	if (sensor_attr == NULL) {
		LOG_ERR("Cannot get sensor attribute");
		k_fatal_halt(K_ERR_KERNEL_PANIC);
	}	

	sensor_indicate_params.attr = sensor_attr;
	sensor_indicate_params.func = sensor_indicate_start;
	sensor_indicate_params.destroy = sensor_indicate_end;

	LOG_INF("Communication thread initialized");
}

void comm_thread_entry(void *param1, void *param2, void *param3)
{
	struct sensor_data data;

	comm_init();

	while (1)
	{
		k_msgq_get(&sensor_queue, &data, K_FOREVER);
		LOG_INF("Sensor data received: %d", data.lumens);

		if (sensor_indicate) {
			LOG_INF("Indicating new value");

			sensor_indicate_params.data = &data;
			sensor_indicate_params.len = sizeof(data);

			k_mutex_lock(&indicating_mutex, K_FOREVER);
			if (bt_gatt_indicate(NULL, &sensor_indicate_params) == 0) {
				LOG_INF("Start waiting on indication condition");
				k_condvar_wait(&indicating_condvar, &indicating_mutex, K_FOREVER);
				LOG_INF("Indication condition set");
			} else {
				LOG_ERR("Cannot complete sensor indication");
			}
			k_mutex_unlock(&indicating_mutex);
			
		} else {
			LOG_INF("No indication set up, data dropped");
		}
	}
}
```

## src/comm.h
```c
#pragma once

#include "sensor.h"

/**
 * @brief Entry point of the Bluetooth communication thread
 */
void comm_thread_entry(void *, void *, void *);
```

## src/sensor.c
```c
#include "sensor.h"

#include <zephyr.h>
#include <logging/log.h>
#include <logging/log_ctrl.h>

#include <devicetree.h>
#include <drivers/gpio.h>

LOG_MODULE_REGISTER(sensor, LOG_LEVEL_DBG);

// ============================================================================
// GPIO devices
// ============================================================================

// Connection LED -------------------------------------------------------------

#define MEAS_BUTTON_NODE DT_NODELABEL(button0)
static const struct gpio_dt_spec meas_button_dt = GPIO_DT_SPEC_GET(MEAS_BUTTON_NODE, gpios);
static struct gpio_callback meas_button_cb;

// ============================================================================
// Queues
// ============================================================================

extern struct k_msgq sensor_queue;

// ============================================================================
// Interrupts
// ============================================================================

// TEST: value used for test data
static uint32_t counter = 0x12345600;

void meas_button_interrupt(const struct device *dev, struct gpio_callback *cb, uint32_t pins) {
    const struct sensor_data data = {
        counter++
    };

    k_msgq_put(&sensor_queue, &data, K_NO_WAIT);
    LOG_INF("Test data sent to queue");
}

// ============================================================================
// Initialization
// ============================================================================

void sensor_init(void)
{
    int err;
    LOG_INF("Initializing sensor thread");

    // GPIO initialization
    err = gpio_pin_configure_dt(&meas_button_dt, GPIO_INPUT | GPIO_INT_DEBOUNCE);
    if (err != 0) {
		LOG_ERR("Send button configuration failed");
        LOG_PANIC();
		k_fatal_halt(K_ERR_KERNEL_PANIC);
    }

    err = gpio_pin_interrupt_configure_dt(&meas_button_dt, GPIO_INT_EDGE_TO_ACTIVE);
    if (err != 0) {
		LOG_ERR("Send button interrupt configuration failed");
        LOG_PANIC();
		k_fatal_halt(K_ERR_KERNEL_PANIC);
    }

    gpio_init_callback(&meas_button_cb, meas_button_interrupt, BIT(meas_button_dt.pin));
    err = gpio_add_callback(meas_button_dt.port, &meas_button_cb);
    if (err != 0) {
		LOG_ERR("Send button callback registration failed");
        LOG_PANIC();
		k_fatal_halt(K_ERR_KERNEL_PANIC);
    }

    LOG_INF("Sensor thread initialized");
}

// ============================================================================
// Entry
// ============================================================================

void sensor_thread_entry(void *param1, void *param2, void *param3)
{
    sensor_init();

    while (1)
    {
        k_sleep(K_FOREVER);
    }
}
```

## src/sensor.h
```c
#pragma once

#include <stdint.h>

/**
 * @brief Sensor data returned
 */
struct sensor_data {
    uint32_t lumens;
};

/**
 * @brief Entry point of the sensor thread
 */
void sensor_thread_entry(void *, void *, void *);
```
